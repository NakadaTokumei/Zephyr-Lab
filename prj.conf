## CMakeLists.txt
```
cmake_minimum_required(VERSION 3.20.0)
find_package(Zephyr REQUIRED HINTS $ENV{ZEPHYR_BASE})

project(zephyr_lab)

target_sources(app PRIVATE src/main.cc
                           src/test_func.cc)
```

## prj.conf
```kconfig
CONFIG_CPP=y

CONFIG_BOOTLOADER_MCUBOOT=y

CONFIG_USB_DEVICE_STACK=y
CONFIG_USB_CDC_ACM=y
CONFIG_UART_LINE_CTRL=y
CONFIG_UART_INTERRUPT_DRIVEN=y
CONFIG_USB_DEVICE_INITIALIZE_AT_BOOT=y

CONFIG_PRINTK=y

CONFIG_SHELL=y
CONFIG_LOG=y
CONFIG_LOG_BACKEND_UART=y
CONFIG_INIT_STACKS=y
CONFIG_THREAD_STACK_INFO=y
CONFIG_KERNEL_SHELL=y
CONFIG_THREAD_MONITOR=y
CONFIG_BOOT_BANNER=y
CONFIG_THREAD_NAME=y
CONFIG_DEVICE_SHELL=y
CONFIG_POSIX_CLOCK=y
CONFIG_DATE_SHELL=y
CONFIG_THREAD_RUNTIME_STATS=y
CONFIG_THREAD_RUNTIME_STATS_USE_TIMING_FUNCTIONS=y
CONFIG_STATS=y
CONFIG_STATS_SHELL=y

CONFIG_HEAP_MEM_POOL_SIZE=4096
```

## usb.overlay
```dts
/ {
    chosen {
        zephyr,uart-mcumgr = &cdc_acm_uart0;
        zephyr,shell-uart = &cdc_acm_uart0;
        zephyr,console = &cdc_acm_uart0;
    };
};

&zephyr_udc0 {
    cdc_acm_uart0: cdc_acm_uart0 {
        compatible = "zephyr,cdc-acm-uart";
    };
};
```

## src/main.cc
```c
#include "test_func.h"

#include <stdio.h>
#include <zephyr/kernel.h>
#include <zephyr/logging/log.h>
#include <zephyr/shell/shell.h>
#include <zephyr/drivers/uart.h>
#include <zephyr/usb/usb_device.h>
#include <zephyr/usb/usbd.h>

LOG_MODULE_REGISTER(main, CONFIG_USB_CDC_ACM_LOG_LEVEL);

static void login_init(void)
{
    if(!CONFIG_SHELL_CMD_ROOT[0])
    {
        shell_set_root_cmd("login");
    }
}

int main(void)
{
    int ret = 0;
    uint32_t dtr = 0;
    const struct device* shell_uart_dev = DEVICE_DT_GET(DT_CHOSEN(zephyr_shell_uart));
	const struct device *uart_dev = DEVICE_DT_GET_ONE(zephyr_cdc_acm_uart);

    LOG_INF("Hello World %s\n", CONFIG_BOARD);

    if(IS_ENABLED(CONFIG_USB_DEVICE_STACK))
    {
        ret = usb_enable(NULL);
        if(ret)
        {
            return 0;
        }
    }

    if(IS_ENABLED(CONFIG_SHELL_START_OBSUCURED))
    {
        login_init();
    }

    while(1)
    {
        printk("Hello World 2\n");
        LOG_INF("Hello World %s\n", CONFIG_BOARD);
        k_sleep(K_SECONDS(10));
    }

    return 0;
}
```

## src/test_func.cc
```c
#include "test_func.h"

#include <zephyr/kernel.h>
#include <zephyr/logging/log.h>
#include <zephyr/shell/shell.h>

#include "tkl/kthread.h"

tkl::kthread<4096> thread1;

LOG_MODULE_REGISTER(test_func);

SHELL_SUBCMD_SET_CREATE(sub_sectoin_cmd, (section_cmd)) = {};

static void thread1Fn(void* p1, void* p2, void* p3)
{
    while(1)
    {
        LOG_INF("1 Minutes Pass");
        k_sleep(K_SECONDS(60));
    }
}

static int cmd1_handler(const struct shell* sh, size_t argc, char** argv)
{
    ARG_UNUSED(sh);
    ARG_UNUSED(argc);
    ARG_UNUSED(argv);

    bool ret = true;

    ret = thread1.Create(thread1Fn);
    if(ret)
    {
        thread1.Setname("thread1");
        printf("Thread Runnting now\r\n");
    }
    else
    {
        printf("Failed to Create Thread => Already Created\r\n");
    }
    return 0;
}

SHELL_SUBCMD_SET_CREATE(sub_section_cmd1, (section_cmd, cmd1)) = {};
SHELL_SUBCMD_ADD((section_cmd), cmd1, &sub_section_cmd1, "help for cmd1", cmd1_handler, 1, 0);

static int cmd2_handler(const struct shell* sh, size_t argc, char** argv)
{
    ARG_UNUSED(sh);
    ARG_UNUSED(argc);
    ARG_UNUSED(argv);

    printf("Thread Aborting now\r\n");
    thread1.Abort();

    return 0;
}

SHELL_SUBCMD_SET_CREATE(sub_section_cmd2, (section_cmd, cmd2)) = {};
SHELL_SUBCMD_ADD((section_cmd), cmd2, &sub_section_cmd2, "help for cmd2", cmd2_handler, 1, 0);

static int cmd3_handler(const struct shell* sh, size_t argc, char** argv)
{
    ARG_UNUSED(sh);
    ARG_UNUSED(argc);
    ARG_UNUSED(argv);

    printf("Thread Starting now\r\n");
    thread1.Start();

    return 0;
}

SHELL_SUBCMD_SET_CREATE(sub_section_cmd3, (section_cmd, cmd3)) = {};
SHELL_SUBCMD_ADD((section_cmd), cmd3, &sub_section_cmd3, "help for cmd3", cmd3_handler, 1, 0);

SHELL_CMD_REGISTER(section_cmd, &sub_sectoin_cmd, "Demo for subcommand", NULL);
```

## src/test_func.h
```c
#ifndef __TEST_FUNC_H__
#define __TEST_FUNC_H__

#endif
```
